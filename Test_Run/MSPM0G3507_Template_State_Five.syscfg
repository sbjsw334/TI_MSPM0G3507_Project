/**
 * @cliArgs --device "MSPM0G350X" --package "LQFP-64(PM)" --part "Default" --product "mspm0_sdk@2.00.01.00"
 * @versions {"tool":"1.20.0+3587"}
 */

/**
 * Import the modules used in this configuration.
 */
const SYSCTL = scripting.addModule("/ti/driverlib/SYSCTL");
const PWM    = scripting.addModule("/ti/driverlib/PWM", {}, false);
const PWM1   = PWM.addInstance();
const PWM2   = PWM.addInstance();
const Board  = scripting.addModule("/ti/driverlib/Board", {}, false);

/**
 * Write custom configuration values to the imported modules.
 */
SYSCTL.forceDefaultClkConfig = true;

Board.peripheral.$suggestSolution          = "DEBUGSS";
Board.peripheral.swclkPin.$suggestSolution = "PA20";
Board.peripheral.swdioPin.$suggestSolution = "PA19";

PWM1.$name                      = "PWM_0";
PWM1.ccIndex                    = [1];
PWM1.enableShadowLoad           = true;
PWM1.clockDivider               = 8;
PWM1.clockPrescale              = 4;
PWM1.timerCount                 = 1000;
PWM1.timerStartTimer            = false;
PWM1.peripheral.$assign         = "TIMA1";
PWM1.peripheral.ccp1Pin.$assign = "PB1";
PWM1.PWM_CHANNEL_1.$name        = "ti_driverlib_pwm_PWM_LEFT";
PWM1.PWM_CHANNEL_1.dutyCycle    = 0;

PWM2.$name                      = "PWM_1";
PWM2.ccIndex                    = [1];
PWM2.ccIndexCmpl                = [1];
PWM2.enableShadowLoad           = true;
PWM2.clockDivider               = 8;
PWM2.clockPrescale              = 4;
PWM2.timerCount                 = 1000;
PWM2.timerStartTimer            = false;
PWM2.peripheral.$assign         = "TIMA0";
PWM2.peripheral.ccp1Pin_cmpl.$assign = "PB13";
PWM2.PWM_CHANNEL_1.$name             = "ti_driverlib_pwm_PWM_RIGHT";
PWM2.PWM_CHANNEL_1.dutyCycle    = 0;
